## app/boards/shields/a_dux/Kconfig.shield
```kconfig
# Copyright (c) 2021 The ZMK Contributors
# SPDX-License-Identifier: MIT

config SHIELD_A.
	def_bool $(shields_list_contains,a_dux_left)

config SHIELD_A.
	def_bool $(shields_list_contains,a_dux_right)
```
